#include "rk3568-vngpu2.dtsi"
/ {
	reserved-memory {
		#address-cells = <2>;
		#size-cells = <2>;
		ranges;

		ramoops: ramoops@110000 {
			compatible = "ramoops";
			reg = <0x0 0x110000 0x0 0xf0000>;
			console-size = <0x80000>;
			ftrace-size = <0x00000>;
			pmsg-size = <0x50000>;
			record-size = <0x20000>;
		};
    
		/* 增加 IEP 保留内存，地址需避开系统已用区域 */
    		iep_roi_memory: iep-roi-memory@11000000 {
        		reg = <0x0 0x11000000 0x0 0x00100000>; /* 1MB */
        		no-map;
    		};
	};
};
